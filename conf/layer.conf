## conf/layer.conf
```bitbake
# We have a conf and classes directory, append to BBPATH
BBPATH .= ":${LAYERDIR}"

# We have a recipes directory, add to BBFILES
BBFILES += " \
	${LAYERDIR}/recipes-*/*/*.bb \
	${LAYERDIR}/recipes-*/*/*.bbappend \
"


BBFILE_COLLECTIONS += "renesas-quick-start"
BBFILE_PATTERN_renesas-quick-start := "^${LAYERDIR}/"
BBFILE_PRIORITY_renesas-quick-start = "8"

# Additional license directories.
LICENSE_PATH += "${LAYERDIR}/custom-licenses"

PREFERRED_VERSION_opencv = "2.4%"
PREFERRED_PROVIDER_opencv-samples = "opencv-samples"
```
